AUTOSAR XML (schema 00046)
package /ApplicationDataTypes
  app type Uint16: category=VALUE
  application record data type RecFoo: category=STRUCTURE
    application record element a: category=VALUE, type=Uint16
    application record element b: category=VALUE, type=Uint16
package /ConstantSpecifications
  constant specification CS_HasValue: value-spec=1
  constant specification CS_EmptyPrim
  constant specification CS_RecFoo
package /SwComponentType
  application sw component type DummySwc
    behavior DummySwc_IB
      shared-parameters:
        parameter data prototype P_EmptyPrim: type=Uint16, init-value=constant-reference=CS_EmptyPrim
        parameter data prototype P_RecFoo: type=RecFoo, init-value=constant-reference=CS_RecFoo

AUTOSAR XML (schema 00046)
package /ConstantSpecifications
  constant specification CS_EmptyPrim: value-spec=42

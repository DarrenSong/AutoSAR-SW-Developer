AUTOSAR XML (schema 4.0)
package /If
  sender receiver interface SrSpeedIf
    data Speed
package /SwComponentType
  application sw component type AppSwc
    provide port PpSpeed: provided-interface=SrSpeedIf
  composition sw component type MidComp
    provide port PpSpeed: provided-interface=SrSpeedIf
    component app: type=AppSwc
    delegate app.PpSpeed <-> outer port MidComp/PpSpeed
  composition sw component type TopComp
    provide port PpSpeed: provided-interface=SrSpeedIf
    component mid: type=MidComp
    delegate mid.PpSpeed <-> outer port TopComp/PpSpeed

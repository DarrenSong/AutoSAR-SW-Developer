AUTOSAR XML (schema 4.0)
package /If
  sender receiver interface SrSpeedIf
    data Speed
package /Signals
  system signal Sig_Speed
  i signal ISig_Speed: system-signal=Sig_Speed
package /SwComponentType
  application sw component type AppSwc
    provide port PpSpeed: provided-interface=SrSpeedIf
  composition sw component type TopComp
    component app: type=AppSwc
package /System
  system DemoSystem
    system mapping SysMap
      data-mappings:
        sender receiver to signal mapping Map_Speed: data-element=app.PpSpeed.Speed, system-signal=Sig_Speed
